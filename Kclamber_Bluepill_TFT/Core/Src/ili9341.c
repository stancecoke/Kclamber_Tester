#include "ili9341.h"
#include "string.h"

/* Pin definitions for Blackpill STM32F4 with SPI2 */
#define ILI9341_CS_PORT     GPIOB
#define ILI9341_CS_PIN      GPIO_PIN_12
#define ILI9341_DC_PORT     GPIOB
#define ILI9341_DC_PIN      GPIO_PIN_14
#define ILI9341_RST_PORT    GPIOB
#define ILI9341_RST_PIN     GPIO_PIN_0


/* Chip Select control */
#define ILI9341_CS_LOW()    HAL_GPIO_WritePin(ILI9341_CS_PORT, ILI9341_CS_PIN, GPIO_PIN_RESET)
#define ILI9341_CS_HIGH()   HAL_GPIO_WritePin(ILI9341_CS_PORT, ILI9341_CS_PIN, GPIO_PIN_SET)

/* Data/Command control */
#define ILI9341_DC_LOW()    HAL_GPIO_WritePin(ILI9341_DC_PORT, ILI9341_DC_PIN, GPIO_PIN_RESET)
#define ILI9341_DC_HIGH()   HAL_GPIO_WritePin(ILI9341_DC_PORT, ILI9341_DC_PIN, GPIO_PIN_SET)

/* Reset control */
#define ILI9341_RST_LOW()   HAL_GPIO_WritePin(ILI9341_RST_PORT, ILI9341_RST_PIN, GPIO_PIN_RESET)
#define ILI9341_RST_HIGH()  HAL_GPIO_WritePin(ILI9341_RST_PORT, ILI9341_RST_PIN, GPIO_PIN_SET)

/* Simple delay function */
static void ILI9341_Delay(uint32_t ms) {
    HAL_Delay(ms);
}

/* Write command to display */
void ILI9341_WriteCommand(uint8_t cmd) {
    ILI9341_DC_LOW();      /* Command mode */
    ILI9341_CS_LOW();
    HAL_SPI_Transmit(&hspi2, &cmd, 1, HAL_MAX_DELAY);
    ILI9341_CS_HIGH();
}

/* Write data to display */
void ILI9341_WriteData(uint8_t data) {
    ILI9341_DC_HIGH();     /* Data mode */
    ILI9341_CS_LOW();
    HAL_SPI_Transmit(&hspi2, &data, 1, HAL_MAX_DELAY);
    ILI9341_CS_HIGH();
}

/* Write 16-bit data to display */
static void ILI9341_Write16(uint16_t data) {
    uint8_t buf[2];
    buf[0] = data >> 8;
    buf[1] = data & 0xFF;
    ILI9341_DC_HIGH();
    ILI9341_CS_LOW();
    HAL_SPI_Transmit(&hspi2, buf, 2, HAL_MAX_DELAY);
    ILI9341_CS_HIGH();
}

/* Initialize ILI9341 display */
void ILI9341_Init(void) {
    /* Reset sequence */
    ILI9341_RST_HIGH();
    ILI9341_Delay(5);
    ILI9341_RST_LOW();
    ILI9341_Delay(20);
    ILI9341_RST_HIGH();
    ILI9341_Delay(150);

    /* Power control A */
    ILI9341_WriteCommand(ILI9341_POWERB);
    ILI9341_WriteData(0x00);
    ILI9341_WriteData(0xD9);
    ILI9341_WriteData(0x30);

    /* Power Sequence Control */
    ILI9341_WriteCommand(ILI9341_POWER_SEQ);
    ILI9341_WriteData(0x64);
    ILI9341_WriteData(0x03);
    ILI9341_WriteData(0x12);
    ILI9341_WriteData(0x81);

    /* Driver Timing Control A */
    ILI9341_WriteCommand(ILI9341_DTCA);
    ILI9341_WriteData(0x85);
    ILI9341_WriteData(0x00);
    ILI9341_WriteData(0x78);

    /* Driver Timing Control B */
    ILI9341_WriteCommand(ILI9341_DTCB);
    ILI9341_WriteData(0x00);
    ILI9341_WriteData(0x00);

    /* Power Control 1 */
    ILI9341_WriteCommand(ILI9341_POWER1);
    ILI9341_WriteData(0x23);

    /* Power Control 2 */
    ILI9341_WriteCommand(ILI9341_POWER2);
    ILI9341_WriteData(0x10);

    /* VCOM Control 1 */
    ILI9341_WriteCommand(ILI9341_VCOM1);
    ILI9341_WriteData(0x3e);
    ILI9341_WriteData(0x28);

    /* VCOM Control 2 */
    ILI9341_WriteCommand(ILI9341_VCOM2);
    ILI9341_WriteData(0x86);

    /* Memory Access Control */
    ILI9341_WriteCommand(ILI9341_MAC);
    ILI9341_WriteData(0b11100000); //gespiegelt

    /* Pixel Format Set */
    ILI9341_WriteCommand(ILI9341_PIXEL_FORMAT);
    ILI9341_WriteData(0x55);  /* 16-bit/pixel */

    /* Frame Rate Control */
    ILI9341_WriteCommand(0xB1);
    ILI9341_WriteData(0x00);
    ILI9341_WriteData(0x10);

    /* Display Function Control */
    ILI9341_WriteCommand(ILI9341_DFC);
    ILI9341_WriteData(0x0A);
    ILI9341_WriteData(0xA2);

    /* 3Gamma Function Disable */
    ILI9341_WriteCommand(ILI9341_3GAMMA_EN);
    ILI9341_WriteData(0x00);

    /* Gamma Curve Selected */
    ILI9341_WriteCommand(ILI9341_GAMMA);
    ILI9341_WriteData(0x01);

    /* Positive Gamma Correction */
    ILI9341_WriteCommand(ILI9341_PGAMMA);
    ILI9341_WriteData(0x0F);
    ILI9341_WriteData(0x31);
    ILI9341_WriteData(0x2B);
    ILI9341_WriteData(0x0C);
    ILI9341_WriteData(0x0E);
    ILI9341_WriteData(0x08);
    ILI9341_WriteData(0x4E);
    ILI9341_WriteData(0xF1);
    ILI9341_WriteData(0x37);
    ILI9341_WriteData(0x07);
    ILI9341_WriteData(0x10);
    ILI9341_WriteData(0x03);
    ILI9341_WriteData(0x0E);
    ILI9341_WriteData(0x09);
    ILI9341_WriteData(0x00);

    /* Negative Gamma Correction */
    ILI9341_WriteCommand(ILI9341_NGAMMA);
    ILI9341_WriteData(0x00);
    ILI9341_WriteData(0x0E);
    ILI9341_WriteData(0x14);
    ILI9341_WriteData(0x03);
    ILI9341_WriteData(0x11);
    ILI9341_WriteData(0x07);
    ILI9341_WriteData(0x31);
    ILI9341_WriteData(0xC1);
    ILI9341_WriteData(0x48);
    ILI9341_WriteData(0x08);
    ILI9341_WriteData(0x0F);
    ILI9341_WriteData(0x0C);
    ILI9341_WriteData(0x31);
    ILI9341_WriteData(0x36);
    ILI9341_WriteData(0x0F);

    /* Column Address Set */
    ILI9341_WriteCommand(ILI9341_COLUMN_ADDR);
    ILI9341_Write16(0x0000);
    ILI9341_Write16(0x013F);

    /* Page Address Set */
    ILI9341_WriteCommand(ILI9341_PAGE_ADDR);
    ILI9341_Write16(0x0000);
    ILI9341_Write16(0x00EF);

    /* Sleep Out */
    ILI9341_WriteCommand(ILI9341_SLEEP_OUT);
    ILI9341_Delay(120);

    /* Display ON */
    ILI9341_WriteCommand(ILI9341_DISPLAY_ON);
    ILI9341_Delay(10);
}

/* Set cursor position */
void ILI9341_SetCursor(uint16_t x, uint16_t y) {
    /* Column address */
    ILI9341_WriteCommand(ILI9341_COLUMN_ADDR);
    ILI9341_Write16(x);
    ILI9341_Write16(ILI9341_WIDTH - 1);

    /* Page address */
    ILI9341_WriteCommand(ILI9341_PAGE_ADDR);
    ILI9341_Write16(y);
    ILI9341_Write16(ILI9341_HEIGHT - 1);
}

/* Fill rectangle with color */
void ILI9341_FillRectangle(uint16_t x, uint16_t y, uint16_t w, uint16_t h, uint16_t color) {
    if ((x >= ILI9341_WIDTH) || (y >= ILI9341_HEIGHT)) return;
    if ((x + w) > ILI9341_WIDTH) w = ILI9341_WIDTH - x;
    if ((y + h) > ILI9341_HEIGHT) h = ILI9341_HEIGHT - y;

    /* Set window */
    ILI9341_WriteCommand(ILI9341_COLUMN_ADDR);
    ILI9341_Write16(x);
    ILI9341_Write16(x + w - 1);

    ILI9341_WriteCommand(ILI9341_PAGE_ADDR);
    ILI9341_Write16(y);
    ILI9341_Write16(y + h - 1);

    /* Write color */
    ILI9341_WriteCommand(ILI9341_GRAM);

    uint32_t pixels = w * h;
    uint8_t buf[2];
    buf[0] = color >> 8;
    buf[1] = color & 0xFF;

    ILI9341_DC_HIGH();
    ILI9341_CS_LOW();
    for (uint32_t i = 0; i < pixels; i++) {
        HAL_SPI_Transmit(&hspi2, buf, 2, HAL_MAX_DELAY);
    }
    ILI9341_CS_HIGH();
}

/* Fill entire screen with color */
void ILI9341_FillScreen(uint16_t color) {
    ILI9341_FillRectangle(0, 0, ILI9341_WIDTH, ILI9341_HEIGHT, color);
}

/* Draw a single pixel */
void ILI9341_DrawPixel(uint16_t x, uint16_t y, uint16_t color) {
    if ((x >= ILI9341_WIDTH) || (y >= ILI9341_HEIGHT)) return;
    ILI9341_FillRectangle(x, y, 1, 1, color);
}

/* Simple 5x7 font bitmap */
static const uint8_t font_5x7[256][5] = {
//    {0x00, 0x00, 0x00, 0x00, 0x00}, /* space */
//    {0x00, 0x00, 0x5F, 0x00, 0x00}, /* ! */
//    {0x00, 0x03, 0x00, 0x03, 0x00}, /* " */
//    {0x14, 0x3E, 0x14, 0x3E, 0x14}, /* # */
//    {0x24, 0x2A, 0x7F, 0x2A, 0x12}, /* $ */
//    {0x23, 0x13, 0x08, 0x64, 0x62}, /* % */
//    {0x36, 0x49, 0x55, 0x22, 0x50}, /* & */
//    {0x00, 0x00, 0x03, 0x00, 0x00}, /* ' */
//    {0x00, 0x1C, 0x22, 0x41, 0x00}, /* ( */
//    {0x00, 0x41, 0x22, 0x1C, 0x00}, /* ) */
//    {0x14, 0x08, 0x3E, 0x08, 0x14}, /* * */
//    {0x08, 0x08, 0x3E, 0x08, 0x08}, /* + */
//    {0x00, 0x50, 0x30, 0x00, 0x00}, /* , */
//    {0x08, 0x08, 0x08, 0x08, 0x08}, /* - */
//    {0x00, 0x60, 0x60, 0x00, 0x00}, /* . */
//    {0x20, 0x10, 0x08, 0x04, 0x02}, /* / */
//    {0x3E, 0x51, 0x49, 0x45, 0x3E}, /* 0 */
//    {0x00, 0x42, 0x7F, 0x40, 0x00}, /* 1 */
//    {0x42, 0x61, 0x51, 0x49, 0x46}, /* 2 */
//    {0x21, 0x41, 0x45, 0x4B, 0x31}, /* 3 */
//    {0x18, 0x14, 0x12, 0x7F, 0x10}, /* 4 */
//    {0x27, 0x45, 0x45, 0x45, 0x39}, /* 5 */
//    {0x3C, 0x4A, 0x49, 0x49, 0x30}, /* 6 */
//    {0x01, 0x71, 0x09, 0x05, 0x03}, /* 7 */
//    {0x36, 0x49, 0x49, 0x49, 0x36}, /* 8 */
//    {0x06, 0x49, 0x49, 0x29, 0x1E}, /* 9 */
//    {0x00, 0x36, 0x36, 0x00, 0x00}, /* : */
//    {0x00, 0x56, 0x36, 0x00, 0x00}, /* ; */
//    {0x08, 0x14, 0x22, 0x41, 0x00}, /* < */
//    {0x14, 0x14, 0x14, 0x14, 0x14}, /* = */
//    {0x00, 0x41, 0x22, 0x14, 0x08}, /* > */
//    {0x02, 0x01, 0x51, 0x09, 0x06}, /* ? */
//    {0x32, 0x49, 0x79, 0x41, 0x3E}, /* @ */
//    {0x7E, 0x11, 0x11, 0x11, 0x7E}, /* A */
//    {0x7F, 0x49, 0x49, 0x49, 0x36}, /* B */
//    {0x3E, 0x41, 0x41, 0x41, 0x22}, /* C */
//    {0x7F, 0x41, 0x41, 0x22, 0x1C}, /* D */
//    {0x7F, 0x49, 0x49, 0x49, 0x41}, /* E */
//    {0x7F, 0x09, 0x09, 0x09, 0x01}, /* F */
//    {0x3E, 0x41, 0x49, 0x49, 0x7A}, /* G */
//    {0x7F, 0x08, 0x08, 0x08, 0x7F}, /* H */
//    {0x00, 0x41, 0x7F, 0x41, 0x00}, /* I */
//    {0x20, 0x40, 0x41, 0x3F, 0x01}, /* J */
//    {0x7F, 0x08, 0x14, 0x22, 0x41}, /* K */
//    {0x7F, 0x40, 0x40, 0x40, 0x40}, /* L */
//    {0x7F, 0x02, 0x0C, 0x02, 0x7F}, /* M */
//    {0x7F, 0x04, 0x08, 0x10, 0x7F}, /* N */
//    {0x3E, 0x41, 0x41, 0x41, 0x3E}, /* O */
//    {0x7F, 0x09, 0x09, 0x09, 0x06}, /* P */
//    {0x3E, 0x41, 0x51, 0x21, 0x5E}, /* Q */
//    {0x7F, 0x09, 0x19, 0x29, 0x46}, /* R */
//    {0x46, 0x49, 0x49, 0x49, 0x31}, /* S */
//    {0x01, 0x01, 0x7F, 0x01, 0x01}, /* T */
//    {0x3F, 0x40, 0x40, 0x40, 0x3F}, /* U */
//    {0x1F, 0x20, 0x40, 0x20, 0x1F}, /* V */
//    {0x3F, 0x40, 0x38, 0x40, 0x3F}, /* W */
//    {0x63, 0x14, 0x08, 0x14, 0x63}, /* X */
//    {0x07, 0x08, 0x70, 0x08, 0x07}, /* Y */
//    {0x61, 0x51, 0x49, 0x45, 0x43}, /* Z */

		{ 0x00, 0x00, 0x00, 0x00, 0x00 },  // 20  32
		{ 0x00, 0x00, 0x4F, 0x00, 0x00 },  // 21  33  !
		{ 0x00, 0x07, 0x00, 0x07, 0x00 },  // 22  34  "
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		{ 0x08, 0x1C, 0x2A, 0x08, 0x08 }   // 7F 127
};

/* Draw a single character */
void ILI9341_DrawChar(uint16_t x, uint16_t y, char ch, uint16_t textColor, uint16_t bgColor, uint8_t fontSize) {
    if (ch < 32 || ch > 126) return;  /* Only printable ASCII */

    const uint8_t *font = font_5x7[ch - 32];
    uint8_t width = 5;
    uint8_t height = 7;

    for (uint8_t i = 0; i < width; i++) {
        uint8_t line = font[i];
        for (uint8_t j = 0; j < height; j++) {
            if (line & 0x01) {
                for (uint8_t fx = 0; fx < fontSize; fx++) {
                    for (uint8_t fy = 0; fy < fontSize; fy++) {
                        ILI9341_DrawPixel(x + i * fontSize + fx, y + j * fontSize + fy, textColor);
                    }
                }
            } else {
                for (uint8_t fx = 0; fx < fontSize; fx++) {
                    for (uint8_t fy = 0; fy < fontSize; fy++) {
                        ILI9341_DrawPixel(x + i * fontSize + fx, y + j * fontSize + fy, bgColor);
                    }
                }
            }
            line >>= 1;
        }
    }
}

/* Draw a string */
void ILI9341_DrawString(uint16_t x, uint16_t y, const char *str, uint16_t textColor, uint16_t bgColor, uint8_t fontSize) {
    while (*str) {
        ILI9341_DrawChar(x, y, *str, textColor, bgColor, fontSize);
        x += (5 + 1) * fontSize;  /* 5 pixels width + 1 space */
        if (x + 5 * fontSize > ILI9341_WIDTH) {
            x = 0;
            y += (7 + 1) * fontSize;  /* 7 pixels height + 1 space */
        }
        str++;
    }
}
